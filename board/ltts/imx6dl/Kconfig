## board/ltts/imx6dl/Kconfig
```kconfig
if TARGET_IMX6DL_LTTS

config SYS_BOARD
	default "imx6dl"

config SYS_VENDOR
	default "ltts"

config SYS_CONFIG_NAME
	default "imx6dl-ltts"

endif
```

## configs/microchip_mpfs_icicle_defconfig
```kconfig
CONFIG_RISCV=y
CONFIG_SMP=y
CONFIG_SBI_V01=y
CONFIG_NR_DRAM_BANKS=1
CONFIG_ENV_SIZE=0x2000
CONFIG_TARGET_MICROCHIP_ICICLE=y
CONFIG_ARCH_RV64I=y
CONFIG_RISCV_SMODE=y
CONFIG_DISTRO_DEFAULTS=y
CONFIG_FIT=y
CONFIG_DEFAULT_DEVICE_TREE="mpfs_icicle"
CONFIG_SYS_PROMPT="RISC-V # "
CONFIG_SYS_RELOC_GD_ENV_ADDR=y
CONFIG_DM_MTD=y
```
