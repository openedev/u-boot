// SPDX-License-Identifier: (GPL-2.0+ OR MIT)
/*
 * Copyright (c) 2020 Engicam srl
 * Copyright (c) 2020 Amarula Solutions(India)
 */

#include "imx8mm-u-boot.dtsi"
#include "imx8mm-engicam-common-u-boot.dtsi"
#include "imx8mm-engicam-icore-mx8mm-u-boot.dtsi"
