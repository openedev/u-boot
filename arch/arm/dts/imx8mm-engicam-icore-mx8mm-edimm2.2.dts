// SPDX-License-Identifier: (GPL-2.0+ OR MIT)
/*
 * Copyright (c) 2019 NXP
 * Copyright (c) 2019 Engicam srl
 * Copyright (c) 2020 Amarula Solutions(India)
 */

/dts-v1/;
#include "imx8mm.dtsi"
#include "imx8mm-engicam-edimm2.2.dtsi"
#include "imx8mm-engicam-icore-mx8mm.dtsi"

/ {
	model = "Engicam i.Core MX8M Mini EDIMM2.2 Starter Kit";
	compatible = "engicam,icore-mx8mm-edimm2.2", "engicam,icore-mx8mm",
		     "fsl,imx8mm";

	chosen {
		stdout-path = &uart2;
	};
};
